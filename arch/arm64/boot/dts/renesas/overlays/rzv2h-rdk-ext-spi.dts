// SPDX-License-Identifier: GPL-2.0+
/*
 * Copyright (C) 2025 Renesas Electronics Corporation
 */

/dts-v1/;
/plugin/;

#include <dt-bindings/gpio/gpio.h>
#include <dt-bindings/pinctrl/rzv2h-pinctrl.h>

/* 40-pin extended GPIO, expanded into UART, SPI, I2C, PWM and other interfaces */
&pinctrl {
    master_spi0_pins: master_spi0 {
        pinmux = <RZV2H_PORT_PINMUX(9, 0, 1)>, /* MOSIA */
             <RZV2H_PORT_PINMUX(9, 1, 1)>,     /* MISOA */
             <RZV2H_PORT_PINMUX(9, 2, 1)>,     /* RSPCKA */
             <RZV2H_PORT_PINMUX(9, 3, 1)>,     /* SSLA0 */
             <RZV2H_PORT_PINMUX(9, 4, 1)>;     /* SSLA1 */
    };
};

&spi0 {
    pinctrl-0 = <&master_spi0_pins>;
    pinctrl-names = "default";
    status = "okay";

	#address-cells = <1>;
	#size-cells = <0>;

    spidev@0 {
        compatible = "semtech,sx1301";
        reg = <0>;
        spi-max-frequency = <2000000>;
    };
};
