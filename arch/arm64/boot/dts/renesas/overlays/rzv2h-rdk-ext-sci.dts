// SPDX-License-Identifier: GPL-2.0+
/*
 * Copyright (C) 2025 Renesas Electronics Corporation
 */

/dts-v1/;
/plugin/;

#include <dt-bindings/pinctrl/rzv2h-pinctrl.h>

/* 40-pin extended GPIO, expanded into UART, SPI, I2C, PWM and other interfaces */
&pinctrl {
    sci5_pins: sci5 {
        pinmux = <RZV2H_PORT_PINMUX(7, 2, 1)>, 	/* TXD5_MOSI5_SDA5 */
             <RZV2H_PORT_PINMUX(7, 3, 1)>; 		/* RXD5_MISO5_SCL5 */
        bias-pull-up;
    };
};

&sci5 {
    pinctrl-0 = <&sci5_pins>;
    pinctrl-names = "default";
    status = "okay";
};
